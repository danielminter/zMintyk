## boards/shields/zmintyk/Kconfig.shield
```kconfig
config SHIELD_ZMINTYK_LEFT
    def_bool $(shields_list_contains,zmintyk_left)

config SHIELD_ZMINTYK_RIGHT
    def_bool $(shields_list_contains,zmkintyk_right)
```

## config/boards/shields/mintyk/Kconfig.defconfig
```kconfig
if SHIELD_MINTYK_LEFT

config ZMK_KEYBOARD_NAME
    default "MintyK"

config ZMK_SPLIT_ROLE_CENTRAL
    default y

endif

if SHILED_MINTYK_LEFT || SHIELD_MINTYK_RIGHT

  config ZMK_SPLIT
      default y
endif
```

## config/boards/shields/mintyk/Kconfig.shield
```kconfig
config SHIELD_MINTYK_LEFT
    def_bool $(shields_list_contains, mintyk_left)

config SHIELD_MINTYK_RIGHT
    def_bool $(shields_list_contains, mintyk_right)
```
